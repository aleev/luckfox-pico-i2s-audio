## sysdrv/tools/board/buildroot/luckfox_pico_defconfig
```kconfig
BR2_arm=y
BR2_cortex_a7=y
BR2_TOOLCHAIN_EXTERNAL=y
BR2_TOOLCHAIN_EXTERNAL_CUSTOM=y
BR2_TOOLCHAIN_EXTERNAL_PATH="../../../../tools/linux/toolchain/arm-rockchip830-linux-uclibcgnueabihf"
BR2_TOOLCHAIN_EXTERNAL_CUSTOM_PREFIX="arm-rockchip830-linux-uclibcgnueabihf"
BR2_TOOLCHAIN_EXTERNAL_GCC_8=y
BR2_TOOLCHAIN_EXTERNAL_HEADERS_5_10=y
BR2_TOOLCHAIN_EXTERNAL_WCHAR=y
BR2_TOOLCHAIN_EXTERNAL_HAS_SSP=y
BR2_TOOLCHAIN_EXTERNAL_CXX=y
BR2_PRIMARY_SITE="http://sources.buildroot.net"
#BR2_PRIMARY_SITE_ONLY=y
BR2_OPTIMIZE_3=y
BR2_TARGET_GENERIC_HOSTNAME="luckfox pico"
BR2_TARGET_GENERIC_ISSUE="Welcome to luckfox pico"
BR2_TARGET_GENERIC_ROOT_PASSWD="luckfox"
BR2_PACKAGE_BUSYBOX_SHOW_OTHERS=y
BR2_PACKAGE_E2FSPROGS_RESIZE2FS=y
#BR2_PACKAGE_PYTHON3=y
#BR2_PACKAGE_PYTHON3_SSL=y
#BR2_PACKAGE_PYTHON_AIOHTTP=y
#BR2_PACKAGE_PYTHON_CLICK=y
#BR2_PACKAGE_PYTHON_ITSDANGEROUS=y
#BR2_PACKAGE_PYTHON_JINJA2=y
#BR2_PACKAGE_PYTHON_PERIPHERY=y
#BR2_PACKAGE_PYTHON_PILLOW=y
#BR2_PACKAGE_PYTHON_SERIAL=y
#BR2_PACKAGE_PYTHON_SETUPTOOLS=y
#BR2_PACKAGE_PYTHON_SMBUS_CFFI=y
#BR2_PACKAGE_PYTHON_SPIDEV=y
#BR2_PACKAGE_PYTHON_WERKZEUG=y
BR2_PACKAGE_OPENSSH=y
#BR2_PACKAGE_SAMBA4=y
BR2_PACKAGE_TIME=y
BR2_PACKAGE_HTOP=y
BR2_PACKAGE_NANO=y
#BR2_PACKAGE_MC=y
##BR2_PACKAGE_ALSA_UTILS=y
#BR2_PACKAGE_ALSA_UTILS_ALSACONF=y
#BR2_PACKAGE_ALSA_UTILS_APLAY=y
#BR2_PACKAGE_ALSA_UTILS_SPEAKER_TEST=y
BR2_PACKAGE_AVAHI=y
BR2_PACKAGE_AVAHI_AUTOIPD=y
BR2_PACKAGE_AVAHI_DAEMON=y
#BR2_PACKAGE_MPD=y
#BR2_PACKAGE_MPD_DSD=y
#BR2_PACKAGE_MPD_FFMPEG=y
#BR2_PACKAGE_MPD_FLAC=y
#BR2_PACKAGE_MPD_MAD=y
#BR2_PACKAGE_MPD_WAVPACK=y
#BR2_PACKAGE_MPD_ALSA=y
#BR2_PACKAGE_MPD_TCP=y
#BR2_PACKAGE_MPD_CURL=y
BR2_PACKAGE_SQUEEZELITE=y
BR2_PACKAGE_SQUEEZELITE_FFMPEG=y
BR2_PACKAGE_SQUEEZELITE_DSD=y
BR2_PACKAGE_UPMPDCLI=y
#
# Audio and video applications
#
BR2_PACKAGE_ALSA_UTILS=y
BR2_PACKAGE_ALSA_UTILS_ALSACONF=y
BR2_PACKAGE_ALSA_UTILS_ACONNECT=y
BR2_PACKAGE_ALSA_UTILS_ALSACTL=y
BR2_PACKAGE_ALSA_UTILS_ALSALOOP=y
BR2_PACKAGE_ALSA_UTILS_ALSAMIXER=y
BR2_PACKAGE_ALSA_UTILS_ALSAUCM=y
BR2_PACKAGE_ALSA_UTILS_ALSATPLG=y
# BR2_PACKAGE_ALSA_UTILS_AMIDI is not set
BR2_PACKAGE_ALSA_UTILS_AMIXER=y
BR2_PACKAGE_ALSA_UTILS_APLAY=y
# BR2_PACKAGE_ALSA_UTILS_APLAYMIDI is not set
# BR2_PACKAGE_ALSA_UTILS_ARECORDMIDI is not set
BR2_PACKAGE_ALSA_UTILS_ASEQDUMP=y
BR2_PACKAGE_ALSA_UTILS_ASEQNET=y
BR2_PACKAGE_ALSA_UTILS_BAT=y
BR2_PACKAGE_ALSA_UTILS_IECSET=y
BR2_PACKAGE_ALSA_UTILS_SPEAKER_TEST=y
# BR2_PACKAGE_ATEST is not set
# BR2_PACKAGE_AUMIX is not set
# BR2_PACKAGE_BLUEZ_ALSA is not set
# BR2_PACKAGE_DVBLAST is not set
# BR2_PACKAGE_DVDAUTHOR is not set
# BR2_PACKAGE_DVDRW_TOOLS is not set
# BR2_PACKAGE_ESPEAK is not set
BR2_PACKAGE_FAAD2=y
BR2_PACKAGE_FFMPEG_ARCH_SUPPORTS=y
BR2_PACKAGE_FFMPEG=y
BR2_PACKAGE_FFMPEG_GPL=y
BR2_PACKAGE_FFMPEG_NONFREE=y
BR2_PACKAGE_FFMPEG_FFMPEG=y
# BR2_PACKAGE_FFMPEG_FFPLAY is not set
# BR2_PACKAGE_FFMPEG_FFPROBE is not set
# BR2_PACKAGE_FFMPEG_AVRESAMPLE is not set
# BR2_PACKAGE_FFMPEG_POSTPROC is not set
BR2_PACKAGE_FFMPEG_SWSCALE=y
BR2_PACKAGE_FFMPEG_ENCODERS="all"
BR2_PACKAGE_FFMPEG_DECODERS="all"
BR2_PACKAGE_FFMPEG_MUXERS="all"
BR2_PACKAGE_FFMPEG_DEMUXERS="all"
BR2_PACKAGE_FFMPEG_PARSERS="all"
BR2_PACKAGE_FFMPEG_BSFS="all"
BR2_PACKAGE_FFMPEG_PROTOCOLS="all"
BR2_PACKAGE_FFMPEG_FILTERS="all"
BR2_PACKAGE_FFMPEG_INDEVS=y
BR2_PACKAGE_FFMPEG_OUTDEVS=y
BR2_PACKAGE_FFMPEG_EXTRACONF=""
BR2_PACKAGE_FLAC=y
# BR2_PACKAGE_FLITE is not set
# BR2_PACKAGE_FLUID_SOUNDFONT is not set
# BR2_PACKAGE_FLUIDSYNTH is not set
# BR2_PACKAGE_GMRENDER_RESURRECT is not set
# BR2_PACKAGE_GSTREAMER1 is not set
BR2_PACKAGE_JACK2=y
BR2_PACKAGE_JACK2_LEGACY=y
# BR2_PACKAGE_JACK2_DBUS is not set
#####
#BR2_PACKAGE_KODI_ARCH_SUPPORTS=y
#####
#
# kodi needs python3 w/ .py modules, a uClibc or glibc toolchain w/ C++, threads, wchar, dynamic library, gcc >= 4.9
#

#
# kodi needs an OpenGL EGL backend with OpenGL or GLES support
#
BR2_PACKAGE_LAME=y
# BR2_PACKAGE_MADPLAY is not set
# BR2_PACKAGE_MIMIC is not set
# BR2_PACKAGE_MINIMODEM is not set

#
# miraclecast needs systemd and a glibc toolchain w/ threads and wchar
#
# BR2_PACKAGE_MJPEGTOOLS is not set
# BR2_PACKAGE_MODPLUGTOOLS is not set
# BR2_PACKAGE_MOTION is not set
BR2_PACKAGE_MPD=y

#
# Archive plugins
#
# BR2_PACKAGE_MPD_BZIP2 is not set
# BR2_PACKAGE_MPD_SQLITE is not set
# BR2_PACKAGE_MPD_ZZIP is not set

#
# Commercial services
#
# BR2_PACKAGE_MPD_QOBUZ is not set
# BR2_PACKAGE_MPD_SOUNDCLOUD is not set

#
# Converter plugins
#
# BR2_PACKAGE_MPD_LIBSAMPLERATE is not set
BR2_PACKAGE_MPD_LIBSOXR=y

#
# Decoder plugins
#
BR2_PACKAGE_MPD_DSD=y
# BR2_PACKAGE_MPD_FAAD2 is not set
BR2_PACKAGE_MPD_FFMPEG=y
BR2_PACKAGE_MPD_FLAC=y
# BR2_PACKAGE_MPD_FLUIDSYNTH is not set
BR2_PACKAGE_MPD_LIBSNDFILE=y
BR2_PACKAGE_MPD_MAD=y
# BR2_PACKAGE_MPD_MODPLUG is not set
BR2_PACKAGE_MPD_MPG123=y
# BR2_PACKAGE_MPD_MUSEPACK is not set
# BR2_PACKAGE_MPD_OPUS is not set
# BR2_PACKAGE_MPD_SIDPLAY is not set
BR2_PACKAGE_MPD_VORBIS=y
BR2_PACKAGE_MPD_WAVPACK=y

#
# Encoder plugins
#
# BR2_PACKAGE_MPD_LAME is not set
# BR2_PACKAGE_MPD_TWOLAME is not set

#
# Input plugins
#
# BR2_PACKAGE_MPD_CDIO_PARANOIA is not set
BR2_PACKAGE_MPD_CURL=y
# BR2_PACKAGE_MPD_LIBMMS is not set
# BR2_PACKAGE_MPD_LIBNFS is not set

#
# samba support needs a glibc toolchain w/ dynamic library, RPC
#

#
# Output plugins
#
BR2_PACKAGE_MPD_ALSA=y
# BR2_PACKAGE_MPD_AO is not set
# BR2_PACKAGE_MPD_HTTPD_OUTPUT is not set
# BR2_PACKAGE_MPD_JACK2 is not set
# BR2_PACKAGE_MPD_OPENAL is not set
# BR2_PACKAGE_MPD_OSS is not set
# BR2_PACKAGE_MPD_PULSEAUDIO is not set
# BR2_PACKAGE_MPD_SHOUTCAST is not set

#
# Miscellaneous plugins
#
# BR2_PACKAGE_MPD_AVAHI_SUPPORT is not set

#
# io_uring support needs a toolchain w/ headers >= 5.1
#
# BR2_PACKAGE_MPD_LIBMPDCLIENT is not set
BR2_PACKAGE_MPD_TCP=y
# BR2_PACKAGE_MPD_UPNP_PUPNP is not set
# BR2_PACKAGE_MPD_UPNP_NPUPNP is not set
BR2_PACKAGE_MPD_UPNP_DISABLED=y

#
# Tag plugins
#
# BR2_PACKAGE_MPD_ID3TAG is not set
# BR2_PACKAGE_MPD_MPC is not set
BR2_PACKAGE_MPG123=y
# BR2_PACKAGE_MPV is not set
# BR2_PACKAGE_MULTICAT is not set
# BR2_PACKAGE_MUSEPACK is not set
# BR2_PACKAGE_NCMPC is not set
# BR2_PACKAGE_OPUS_TOOLS is not set
BR2_PACKAGE_PIPEWIRE is not set
BR2_PACKAGE_PULSEAUDIO_HAS_ATOMIC=y
BR2_PACKAGE_PULSEAUDIO is not set
# BR2_PACKAGE_SOX is not set
# BR2_PACKAGE_SQUEEZELITE is not set
# BR2_PACKAGE_TSTOOLS is not set
# BR2_PACKAGE_TWOLAME is not set
# BR2_PACKAGE_UDPXY is not set
BR2_PACKAGE_UPMPDCLI=y
# BR2_PACKAGE_V4L2GRAB is not set
# BR2_PACKAGE_V4L2LOOPBACK is not set
# BR2_PACKAGE_VLC is not set
BR2_PACKAGE_VORBIS_TOOLS=y
BR2_PACKAGE_WAVPACK=y
# BR2_PACKAGE_YAVTA is not set
# BR2_PACKAGE_YMPD is not set
# BR2_PACKAGE_ZYNADDSUBFX is not set
#
#Audio/Sound
#
BR2_PACKAGE_ALSA_LIB=y
BR2_PACKAGE_ALSA_LIB_DEVDIR="/dev/snd"
BR2_PACKAGE_ALSA_LIB_PCM_PLUGINS="all"
BR2_PACKAGE_ALSA_LIB_CTL_PLUGINS="all"
BR2_PACKAGE_ALSA_LIB_ALOAD=y
BR2_PACKAGE_ALSA_LIB_MIXER=y
BR2_PACKAGE_ALSA_LIB_PCM=y
BR2_PACKAGE_ALSA_LIB_RAWMIDI=y
BR2_PACKAGE_ALSA_LIB_HWDEP=y
BR2_PACKAGE_ALSA_LIB_SEQ=y
BR2_PACKAGE_ALSA_LIB_UCM=y
BR2_PACKAGE_ALSA_LIB_ALISP=y
BR2_PACKAGE_ALSA_LIB_OLD_SYMBOLS=y
BR2_PACKAGE_ALSA_PLUGINS=y
# BR2_PACKAGE_ALURE is not set
# BR2_PACKAGE_AUBIO is not set
# BR2_PACKAGE_BCG729 is not set
# BR2_PACKAGE_CAPS is not set
BR2_PACKAGE_FDK_AAC_ARCH_SUPPORTS=y
# BR2_PACKAGE_FDK_AAC is not set
BR2_PACKAGE_LIBAO=y
# BR2_PACKAGE_LIBASPLIB is not set
# BR2_PACKAGE_LIBBROADVOICE is not set
# BR2_PACKAGE_LIBCDAUDIO is not set
# BR2_PACKAGE_LIBCDDB is not set
# BR2_PACKAGE_LIBCDIO is not set
# BR2_PACKAGE_LIBCDIO_PARANOIA is not set
# BR2_PACKAGE_LIBCODEC2 is not set
# BR2_PACKAGE_LIBCUE is not set
# BR2_PACKAGE_LIBCUEFILE is not set
# BR2_PACKAGE_LIBEBUR128 is not set
# BR2_PACKAGE_LIBG7221 is not set
BR2_PACKAGE_LIBGSM=y
BR2_PACKAGE_LIBID3TAG=y
# BR2_PACKAGE_LIBILBC is not set
# BR2_PACKAGE_LIBLO is not set
BR2_PACKAGE_LIBMAD=y
BR2_PACKAGE_LIBMAD_OPTIMIZATION_DEFAULT=y
# BR2_PACKAGE_LIBMAD_OPTIMIZATION_SPEED is not set
# BR2_PACKAGE_LIBMAD_OPTIMIZATION_ACCURACY is not set
# BR2_PACKAGE_LIBMAD_SSO is not set
BR2_PACKAGE_LIBMAD_ASO=y
# BR2_PACKAGE_LIBMAD_STRICT_ISO is not set
# BR2_PACKAGE_LIBMODPLUG is not set
# BR2_PACKAGE_LIBMPD is not set
BR2_PACKAGE_LIBMPDCLIENT=y
# BR2_PACKAGE_LIBREPLAYGAIN is not set
BR2_PACKAGE_LIBSAMPLERATE=y
# BR2_PACKAGE_LIBSIDPLAY2 is not set
# BR2_PACKAGE_LIBSILK is not set
BR2_PACKAGE_LIBSNDFILE=y
# BR2_PACKAGE_LIBSOUNDTOUCH is not set
BR2_PACKAGE_LIBSOXR=y
BR2_PACKAGE_LIBVORBIS=y
# BR2_PACKAGE_LILV is not set
# BR2_PACKAGE_LV2 is not set
# BR2_PACKAGE_MP4V2 is not set
BR2_PACKAGE_OPENAL_ARCH_SUPPORTS=y
# BR2_PACKAGE_OPENAL is not set
# BR2_PACKAGE_OPENCORE_AMR is not set
BR2_PACKAGE_OPUS=y
# BR2_PACKAGE_OPUS_FIXED_POINT is not set
# BR2_PACKAGE_OPUSFILE is not set
BR2_PACKAGE_PORTAUDIO=y
BR2_PACKAGE_PORTAUDIO_ALSA=y
# BR2_PACKAGE_PORTAUDIO_OSS is not set
# BR2_PACKAGE_PORTAUDIO_CXX is not set
# BR2_PACKAGE_SBC is not set
# BR2_PACKAGE_SPANDSP is not set
BR2_PACKAGE_SPEEX=y
BR2_PACKAGE_SPEEX_ARM5E=y
BR2_PACKAGE_SPEEXDSP=y
# BR2_PACKAGE_SRATOM is not set
# BR2_PACKAGE_TAGLIB is not set
# BR2_PACKAGE_TINYALSA is not set
BR2_PACKAGE_TREMOR=y
# BR2_PACKAGE_VO_AACENC is not set
BR2_PACKAGE_WEBRTC_AUDIO_PROCESSING_ARCH_SUPPORTS=y
# BR2_PACKAGE_WEBRTC_AUDIO_PROCESSING is not set
```
